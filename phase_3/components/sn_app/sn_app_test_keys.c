#include "sn_app_internal.h"

#include <string.h>

/*
 * Test-only deterministic scalars. These are public constants in source and are
 * not secrets. They exist solely to make the software signing path repeatable
 * in QEMU. They must never be used outside this research test suite.
 */
static const uint8_t s_test_scalars[SN_TEST_KEY_COUNT][SN_HASH_LEN] = {
    {0x5C, 0x1F, 0xF9, 0x4F, 0xBC, 0xAF, 0xF0, 0x82, 0xF8, 0xCB, 0xB2, 0x3A,
     0x2E, 0xE8, 0x69, 0x37, 0xB3, 0xAA, 0x37, 0x4E, 0x3A, 0x7C, 0x20, 0xB9,
     0xC2, 0x9C, 0x39, 0xB5, 0x13, 0xB6, 0x67, 0x72},
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    {0x83, 0xF0, 0x18, 0xA5, 0x3D, 0x53, 0xAE, 0xC9, 0x14, 0x2E, 0x67, 0xCA,
     0x37, 0x2F, 0x42, 0xAE, 0x6F, 0x0D, 0x2D, 0x86, 0xE3, 0x90, 0xD0, 0x4E,
     0x23, 0x31, 0x0A, 0x13, 0x63, 0x21, 0x47, 0x4E},
};

static sn_test_key_t s_keys[SN_TEST_KEY_COUNT];
static bool s_ready;

esp_err_t sn_app_test_keys_init(void)
{
    if (s_ready) {
        return ESP_OK;
    }
    memset(s_keys, 0, sizeof(s_keys));
    for (size_t i = 0; i < SN_TEST_KEY_COUNT; i++) {
        esp_err_t err = sn_soft_signer_init(&s_keys[i].signer, s_test_scalars[i]);
        if (err != ESP_OK) {
            sn_app_test_keys_deinit();
            return err;
        }
        err = sn_soft_signer_get_pubkey(&s_keys[i].signer, s_keys[i].pubkey);
        if (err != ESP_OK) {
            sn_app_test_keys_deinit();
            return err;
        }
        s_keys[i].ready = true;
    }
    s_ready = true;
    return ESP_OK;
}

void sn_app_test_keys_deinit(void)
{
    for (size_t i = 0; i < SN_TEST_KEY_COUNT; i++) {
        if (s_keys[i].ready) {
            sn_soft_signer_deinit(&s_keys[i].signer);
        }
        memset(&s_keys[i], 0, sizeof(s_keys[i]));
    }
    s_ready = false;
}

const sn_test_key_t *sn_app_test_key(size_t index)
{
    if (!s_ready || index >= SN_TEST_KEY_COUNT || !s_keys[index].ready) {
        return NULL;
    }
    return &s_keys[index];
}

sn_signer_t sn_app_test_signer(size_t index)
{
    const sn_test_key_t *key = sn_app_test_key(index);
    if (key == NULL) {
        sn_signer_t invalid = {0};
        return invalid;
    }
    return sn_soft_signer_as_signer((sn_soft_signer_t *)&key->signer);
}

int sn_app_test_key_index_for_pubkey(const uint8_t pubkey[SN_PUBKEY_LEN])
{
    if (!s_ready || pubkey == NULL) {
        return -1;
    }
    for (size_t i = 0; i < SN_TEST_KEY_COUNT; i++) {
        if (s_keys[i].ready &&
            memcmp(s_keys[i].pubkey, pubkey, SN_PUBKEY_LEN) == 0) {
            return (int)i;
        }
    }
    return -1;
}
